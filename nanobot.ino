#include <WiFi.h>
#include <HTTPClient.h>
#include <ArduinoJson.h>
#include <Wire.h>
#include <Adafruit_GFX.h>
#include <Adafruit_SSD1306.h>
#include <Adafruit_MPU6050.h>
#include <Adafruit_Sensor.h>
#include <time.h>
#include "nanobot_intro.h"    
    

/* ================= CONFIGURATION ================= */
const char* ssid     = "Chandu";
const char* password = "9949177088";

#define SDA_PIN 8
#define SCL_PIN 9
#define TOUCH_PIN_1 4      // Left touch sensor
#define TOUCH_PIN_2 3      // Right touch sensor
#define BUZZER_PIN 10
#define OLED_ADDR 0x3C

// Vizag coordinates
#define LATITUDE "17.68"
#define LONGITUDE "83.21"

Adafruit_SSD1306 display(128, 64, &Wire, -1);
Adafruit_MPU6050 mpu;

/* ================= FACIAL EXPRESSION BITMAPS (128x64) ================= */
// Define all facial expression indices
#define FACE_IDX_SMILE_NORMAL    0
#define FACE_IDX_BLUSHY_SMILE    1
#define FACE_IDX_ANGRY           2
#define FACE_IDX_CRYING          3
#define FACE_IDX_SHOCKING        4
#define FACE_IDX_SMIRKING        5
#define FACE_IDX_EVIL_SMILE      6
#define FACE_IDX_EYES_ROLLING    7
#define FACE_IDX_FACE_EXHALING   8
#define FACE_IDX_REVERSE_FACE    9
#define FACE_IDX_EYES_MOUTH_OUT  10
#define FACE_IDX_SLEEP           11
#define TOTAL_FACE_EXPRESSIONS   12

const unsigned char FACE_SMILE_NORMAL[] PROGMEM = {
    0xff, 0xff, 0xff, 0xff, 0xff, 0xff, 0xff, 0xff, 0xff, 0xff, 0xff, 0xff, 0xff, 0xff, 0xff, 0xff, 
    0xff, 0xff, 0xff, 0xff, 0xff, 0xff, 0xff, 0xff, 0xff, 0xff, 0xff, 0xff, 0xff, 0xff, 0xff, 0xff, 
    0xff, 0xff, 0xff, 0xff, 0xff, 0xff, 0xff, 0xff, 0xff, 0xff, 0xff, 0xff, 0xff, 0xff, 0xff, 0xff, 
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    0xff, 0xff, 0xff, 0xff, 0xff, 0xff, 0xff, 0xff, 0xff, 0xff, 0xff, 0xff, 0xff, 0xff, 0xff, 0xff
};

const unsigned char FACE_BLUSHY_SMILE[] PROGMEM = {
    0xff, 0xff, 0xff, 0xff, 0xff, 0xff, 0xff, 0xff, 0xff, 0xff, 0xff, 0xff, 0xff, 0xff, 0xff, 0xff, 
    0xff, 0xff, 0xff, 0xff, 0xff, 0xff, 0xff, 0xff, 0xff, 0xff, 0xff, 0xff, 0xff, 0xff, 0xff, 0xff, 
    0xff, 0xff, 0xff, 0xff, 0xff, 0xff, 0xff, 0xff, 0xff, 0xff, 0xff, 0xff, 0xff, 0xff, 0xff, 0xff, 
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    0xff, 0xff, 0xff, 0xff, 0xff, 0xff, 0xff, 0xff, 0xff, 0xff, 0xff, 0xff, 0xff, 0xff, 0xff, 0xff
};

const unsigned char FACE_ANGRY[] PROGMEM = {
    0xff, 0xff, 0xff, 0xff, 0xff, 0xff, 0xff, 0xff, 0xff, 0xff, 0xff, 0xff, 0xff, 0xff, 0xff, 0xff, 
    0xff, 0xff, 0xff, 0xff, 0xff, 0xff, 0xff, 0xff, 0xff, 0xff, 0xff, 0xff, 0xff, 0xff, 0xff, 0xff, 
    0xff, 0xff, 0xff, 0xff, 0xff, 0xff, 0xff, 0xff, 0xff, 0xff, 0xff, 0xff, 0xff, 0xff, 0xff, 0xff, 
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    0xff, 0xff, 0xff, 0xff, 0xff, 0xff, 0xff, 0xff, 0xff, 0xff, 0xff, 0xff, 0xff, 0xff, 0xff, 0xff
};

const unsigned char FACE_CRYING[] PROGMEM = {
    0xff, 0xff, 0xff, 0xff, 0xff, 0xff, 0xff, 0xff, 0xff, 0xff, 0xff, 0xff, 0xff, 0xff, 0xff, 0xff, 
    0xff, 0xff, 0xff, 0xff, 0xff, 0xff, 0xff, 0xff, 0xff, 0xff, 0xff, 0xff, 0xff, 0xff, 0xff, 0xff, 
    0xff, 0xff, 0xff, 0xff, 0xff, 0xff, 0xff, 0xff, 0xff, 0xff, 0xff, 0xff, 0xff, 0xff, 0xff, 0xff, 
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    0xff, 0xff, 0xff, 0xff, 0xff, 0xff, 0xff, 0xff, 0xff, 0xff, 0xff, 0xff, 0xff, 0xff, 0xff, 0xff

};

const unsigned char FACE_SHOCKING[] PROGMEM = {
    0xff, 0xff, 0xff, 0xff, 0xff, 0xff, 0xff, 0xff, 0xff, 0xff, 0xff, 0xff, 0xff, 0xff, 0xff, 0xff, 
    0xff, 0xff, 0xff, 0xff, 0xff, 0xff, 0xff, 0xff, 0xff, 0xff, 0xff, 0xff, 0xff, 0xff, 0xff, 0xff, 
    0xff, 0xff, 0xff, 0xff, 0xff, 0xff, 0xff, 0xff, 0xff, 0xff, 0xff, 0xff, 0xff, 0xff, 0xff, 0xff, 
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    0xff, 0xff, 0xff, 0xff, 0xff, 0xff, 0xff, 0xff, 0xff, 0xff, 0xff, 0xff, 0xff, 0xff, 0xff, 0xff
};

const unsigned char FACE_SMIRKING[] PROGMEM = {
    0xff, 0xff, 0xff, 0xff, 0xff, 0xff, 0xff, 0xff, 0xff, 0xff, 0xff, 0xff, 0xff, 0xff, 0xff, 0xff, 
    0xff, 0xff, 0xff, 0xff, 0xff, 0xff, 0xff, 0xff, 0xff, 0xff, 0xff, 0xff, 0xff, 0xff, 0xff, 0xff, 
    0xff, 0xff, 0xff, 0xff, 0xff, 0xff, 0xff, 0xff, 0xff, 0xff, 0xff, 0xff, 0xff, 0xff, 0xff, 0xff, 
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    0xff, 0xff, 0xff, 0xff, 0xff, 0xff, 0xff, 0xff, 0xff, 0xff, 0xff, 0xff, 0xff, 0xff, 0xff, 0xff
};

const unsigned char FACE_EVIL_SMILE[] PROGMEM = {
    0xff, 0xff, 0xff, 0xff, 0xff, 0xff, 0xff, 0xff, 0xff, 0xff, 0xff, 0xff, 0xff, 0xff, 0xff, 0xff, 
    0xff, 0xff, 0xff, 0xff, 0xff, 0xff, 0xff, 0xff, 0xff, 0xff, 0xff, 0xff, 0xff, 0xff, 0xff, 0xff, 
    0xff, 0xff, 0xff, 0xff, 0xff, 0xff, 0xff, 0xff, 0xff, 0xff, 0xff, 0xff, 0xff, 0xff, 0xff, 0xff, 
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    0xff, 0xff, 0xff, 0xff, 0xff, 0xff, 0xff, 0xff, 0xff, 0xff, 0xff, 0xff, 0xff, 0xff, 0xff, 0xff
};

const unsigned char FACE_EYES_ROLLING[] PROGMEM = {
    0xff, 0xff, 0xff, 0xff, 0xff, 0xff, 0xff, 0xff, 0xff, 0xff, 0xff, 0xff, 0xff, 0xff, 0xff, 0xff, 
    0xff, 0xff, 0xff, 0xff, 0xff, 0xff, 0xff, 0xff, 0xff, 0xff, 0xff, 0xff, 0xff, 0xff, 0xff, 0xff, 
    0xff, 0xff, 0xff, 0xff, 0xff, 0xff, 0xff, 0xff, 0xff, 0xff, 0xff, 0xff, 0xff, 0xff, 0xff, 0xff, 
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    0xff, 0xff, 0xff, 0xff, 0xff, 0xff, 0xff, 0xff, 0xff, 0xff, 0xff, 0xff, 0xff, 0xff, 0xff, 0xff
};

const unsigned char FACE_EXHALING[] PROGMEM = {
    0xff, 0xff, 0xff, 0xff, 0xff, 0xff, 0xff, 0xff, 0xff, 0xff, 0xff, 0xff, 0xff, 0xff, 0xff, 0xff, 
    0xff, 0xff, 0xff, 0xff, 0xff, 0xff, 0xff, 0xff, 0xff, 0xff, 0xff, 0xff, 0xff, 0xff, 0xff, 0xff, 
    0xff, 0xff, 0xff, 0xff, 0xff, 0xff, 0xff, 0xff, 0xff, 0xff, 0xff, 0xff, 0xff, 0xff, 0xff, 0xff, 
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    0xff, 0xff, 0xff, 0xff, 0xff, 0xff, 0xff, 0xff, 0xff, 0xff, 0xff, 0xff, 0xff, 0xff, 0xff, 0xff
};

const unsigned char FACE_REVERSE[] PROGMEM = {
    0xff, 0xff, 0xff, 0xff, 0xff, 0xff, 0xff, 0xff, 0xff, 0xff, 0xff, 0xff, 0xff, 0xff, 0xff, 0xff, 
    0xff, 0xff, 0xff, 0xff, 0xff, 0xff, 0xff, 0xff, 0xff, 0xff, 0xff, 0xff, 0xff, 0xff, 0xff, 0xff, 
    0xff, 0xff, 0xff, 0xff, 0xff, 0xff, 0xff, 0xff, 0xff, 0xff, 0xff, 0xff, 0xff, 0xff, 0xff, 0xff, 
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    0xff, 0xff, 0xff, 0xff, 0xff, 0xff, 0xff, 0xff, 0xff, 0xff, 0xff, 0xff, 0xff, 0xff, 0xff, 0xff
};

const unsigned char FACE_EYES_MOUTH_OUTLINE[] PROGMEM = {
    0xff, 0xff, 0xff, 0xff, 0xff, 0xff, 0xff, 0xff, 0xff, 0xff, 0xff, 0xff, 0xff, 0xff, 0xff, 0xff, 
    0xff, 0xff, 0xff, 0xff, 0xff, 0xff, 0xff, 0xff, 0xff, 0xff, 0xff, 0xff, 0xff, 0xff, 0xff, 0xff, 
    0xff, 0xff, 0xff, 0xff, 0xff, 0xff, 0xff, 0xff, 0xff, 0xff, 0xff, 0xff, 0xff, 0xff, 0xff, 0xff, 
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    0xff, 0xff, 0xff, 0xff, 0xff, 0xff, 0xff, 0xff, 0xff, 0xff, 0xff, 0xff, 0xff, 0xff, 0xff, 0xff
};

const unsigned char FACE_SLEEP[] PROGMEM = {
    0xff, 0xff, 0xff, 0xff, 0xff, 0xff, 0xff, 0xff, 0xff, 0xff, 0xff, 0xff, 0xff, 0xff, 0xff, 0xff, 
    0xff, 0xff, 0xff, 0xff, 0xff, 0xff, 0xff, 0xff, 0xff, 0xff, 0xff, 0xff, 0xff, 0xff, 0xff, 0xff, 
    0xff, 0xff, 0xff, 0xff, 0xff, 0xff, 0xff, 0xff, 0xff, 0xff, 0xff, 0xff, 0xff, 0xff, 0xff, 0xff, 
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    0xff, 0xff, 0xff, 0xff, 0xff, 0xff, 0xff, 0xff, 0xff, 0xff, 0xff, 0xff, 0xff, 0xff, 0xff, 0xff
};

// Face expression array
const unsigned char* faceExpressions[TOTAL_FACE_EXPRESSIONS] = {
  FACE_SMILE_NORMAL,      // 0
  FACE_BLUSHY_SMILE,      // 1
  FACE_ANGRY,             // 2
  FACE_CRYING,            // 3
  FACE_SHOCKING,          // 4
  FACE_SMIRKING,          // 5
  FACE_EVIL_SMILE,        // 6
  FACE_EYES_ROLLING,      // 7
  FACE_EXHALING,          // 8
  FACE_REVERSE,           // 9
  FACE_EYES_MOUTH_OUTLINE,// 10
  FACE_SLEEP              // 11
};


/* ================= WEATHER ICON BITMAPS (16x16) ================= */
const unsigned char icon_sunny [] PROGMEM = {
  0x01, 0x00, 0x01, 0x00, 0x11, 0x10, 0x09, 0x20, 0x07, 0xc0, 0x0f, 0xe0, 0x1f, 0xf0, 0x1f, 0xf0, 
  0x1f, 0xf0, 0x0f, 0xe0, 0x07, 0xc0, 0x09, 0x20, 0x11, 0x10, 0x01, 0x00, 0x01, 0x00, 0x00, 0x00
};

const unsigned char icon_cloudy [] PROGMEM = {
  0x00, 0x00, 0x00, 0x00, 0x0f, 0x00, 0x10, 0x80, 0x60, 0x40, 0x80, 0x20, 0x80, 0x10, 0x80, 0x10, 
  0x80, 0x10, 0xc0, 0x30, 0x7f, 0xe0, 0x00, 0x00, 0x00, 0x00, 0x00, 0x00, 0x00, 0x00, 0x00, 0x00
};

const unsigned char icon_rainy [] PROGMEM = {
  0x0f, 0x00, 0x10, 0x80, 0x60, 0x40, 0x80, 0x20, 0x80, 0x10, 0xc0, 0x30, 0x7f, 0xe0, 0x00, 0x00, 
  0x12, 0x40, 0x09, 0x20, 0x12, 0x40, 0x09, 0x20, 0x12, 0x40, 0x00, 0x00, 0x00, 0x00, 0x00, 0x00
};

const unsigned char icon_foggy [] PROGMEM = {
  0x00, 0x00, 0x00, 0x00, 0x7f, 0xf0, 0x00, 0x00, 0x00, 0x00, 0x7f, 0xf0, 0x00, 0x00, 0x00, 0x00, 
  0x7f, 0xf0, 0x00, 0x00, 0x00, 0x00, 0x7f, 0xf0, 0x00, 0x00, 0x00, 0x00, 0x00, 0x00, 0x00, 0x00
};

const unsigned char icon_storm [] PROGMEM = {
  0x0f, 0x00, 0x10, 0x80, 0x60, 0x40, 0x80, 0x20, 0xc0, 0x30, 0x7f, 0xe0, 0x01, 0x00, 0x03, 0x80, 
  0x01, 0x00, 0x03, 0x00, 0x01, 0x80, 0x03, 0x00, 0x01, 0x00, 0x00, 0x00, 0x00, 0x00, 0x00, 0x00
};

const unsigned char icon_snowy [] PROGMEM = {
  0x0f, 0x00, 0x10, 0x80, 0x60, 0x40, 0x80, 0x20, 0xc0, 0x30, 0x7f, 0xe0, 0x00, 0x00, 0x24, 0x90, 
  0x19, 0x20, 0x0f, 0xc0, 0x19, 0x20, 0x24, 0x90, 0x00, 0x00, 0x00, 0x00, 0x00, 0x00, 0x00, 0x00
};

/* ================= STATE MANAGEMENT ================= */
enum Screen { SCR_FACE, SCR_TIME, SCR_WEATHER, SCR_STATS, SCR_SENSOR_DEBUG };
enum Mood { HAPPY, FEAR, SHAKE, SLEEP, ANGRY, LOVE, DIZZY, CRINGE, EXCITED, SAD, CONFUSED, SURPRISED, ANNOYED, TIRED, PLAYFUL };

Screen currentScr = SCR_FACE;
Mood currentMood = HAPPY;

struct WeatherData {
  float temp;
  float humidity;
  int weatherCode;
  bool valid;
} weather;

unsigned long interactionTimer = 0;
unsigned long lastBlink = 0;
unsigned long lastWeatherUpdate = 0;
unsigned long lastMotionCheck = 0;
int blinkStage = 0; 
unsigned long lastTouch1 = 0;
unsigned long lastTouch2 = 0;
int touchCount1 = 0;
int touchCount2 = 0;
unsigned long moodTimer = 0;
bool motionDetected = false;
unsigned long lastMotionTrigger = 0;

// Sensor readings for debug
float lastGyroMag = 0;
float lastAccelMag = 0;

/* ================= SOUND EFFECTS ================= */
void playTone(int freq, int dur) {
  tone(BUZZER_PIN, freq, dur);
  delay(dur);
  noTone(BUZZER_PIN);
}

void soundEffect(String effect) {
  if (effect == "hi") {
    playTone(1000, 100);
    playTone(1400, 150);
  }
  else if (effect == "scared") {
    for(int i=0; i<5; i++) {
      playTone(random(400, 800), 40);
      delay(20);
    }
  }
  else if (effect == "tap") {
    playTone(2200, 30);
  }
  else if (effect == "tap2") {
    playTone(2400, 30);
  }
  else if (effect == "both") {
    playTone(2000, 40);
    playTone(2600, 40);
  }
  else if (effect == "angry") {
    playTone(200, 100);
    delay(50);
    playTone(150, 150);
  }
  else if (effect == "sleepy") {
    playTone(800, 200);
    delay(100);
    playTone(600, 300);
  }
  else if (effect == "love") {
    playTone(1500, 100);
    playTone(1800, 100);
    playTone(2100, 150);
  }
  else if (effect == "dizzy") {
    for(int i=0; i<3; i++) {
      playTone(1000 + i*200, 80);
      playTone(1000 - i*200, 80);
    }
  }
  else if (effect == "cringe") {
    playTone(1200, 60);
    delay(40);
    playTone(1100, 60);
    delay(40);
    playTone(1000, 60);
    delay(80);
    playTone(1300, 50);
    delay(30);
    playTone(1200, 50);
  }
  else if (effect == "excited") {
    playTone(1500, 80);
    playTone(1800, 80);
    playTone(2100, 80);
    playTone(2400, 120);
  }
  else if (effect == "sad") {
    playTone(800, 200);
    delay(50);
    playTone(600, 250);
    delay(50);
    playTone(400, 300);
  }
  else if (effect == "confused") {
    playTone(800, 100);
    delay(30);
    playTone(1000, 100);
    delay(30);
    playTone(900, 150);
  }
  else if (effect == "surprised") {
    playTone(600, 50);
    playTone(900, 50);
    playTone(1400, 100);
  }
  else if (effect == "annoyed") {
    playTone(300, 100);
    delay(50);
    playTone(280, 150);
    delay(50);
    playTone(260, 100);
  }
  else if (effect == "tired") {
    playTone(600, 300);
    delay(100);
    playTone(500, 400);
  }
  else if (effect == "playful") {
    playTone(1200, 80);
    playTone(1400, 80);
    playTone(1200, 80);
    playTone(1600, 120);
  }
}

/* ================= WEATHER FUNCTIONS ================= */
void updateWeather() {
  if (WiFi.status() != WL_CONNECTED) return;
  
  HTTPClient http;
  String url = "http://api.open-meteo.com/v1/forecast?latitude=" + String(LATITUDE) + 
               "&longitude=" + String(LONGITUDE) + 
               "&current=temperature_2m,relative_humidity_2m,weather_code&timezone=auto";
  
  http.begin(url);
  int httpCode = http.GET();
  
  if(httpCode == HTTP_CODE_OK) {
    String payload = http.getString();
    StaticJsonDocument<512> doc;
    DeserializationError error = deserializeJson(doc, payload);
    
    if (!error) {
      weather.temp = doc["current"]["temperature_2m"];
      weather.humidity = doc["current"]["relative_humidity_2m"];
      weather.weatherCode = doc["current"]["weather_code"];
      weather.valid = true;
      lastWeatherUpdate = millis();
    }
  }
  http.end();
}

const unsigned char* getWeatherIcon(int code) {
  if (code == 0 || code == 1) return icon_sunny;
  if (code == 2) return icon_cloudy;
  if (code == 3) return icon_cloudy;
  if (code == 45 || code == 48) return icon_foggy;
  if (code >= 51 && code <= 67) return icon_rainy;
  if (code >= 71 && code <= 77) return icon_snowy;
  if (code >= 80 && code <= 82) return icon_rainy;
  if (code >= 85 && code <= 86) return icon_snowy;
  if (code >= 95 && code <= 99) return icon_storm;
  return icon_cloudy;
}

String getWeatherDescription(int code) {
  if (code == 0) return "Clear";
  if (code <= 3) return "Cloudy";
  if (code <= 48) return "Foggy";
  if (code <= 67) return "Rainy";
  if (code <= 77) return "Snowy";
  if (code <= 82) return "Showers";
  if (code <= 86) return "Snow";
  return "Storm";
}

/* ================= DRAWING FUNCTIONS WITH BITMAPS ================= */
void drawFaceFromBitmap(int faceIndex) {
  if (faceIndex >= 0 && faceIndex < TOTAL_FACE_EXPRESSIONS) {
    display.drawBitmap(0, 0, faceExpressions[faceIndex], 128, 64, WHITE);
  }
}

// Mood to Face Expression mapping
int getMoodFaceIndex(Mood mood) {
  switch(mood) {
    case HAPPY:
    case EXCITED:
    case PLAYFUL:
      return FACE_IDX_SMILE_NORMAL;
    case LOVE:
      return FACE_IDX_BLUSHY_SMILE;
    case ANGRY:
    case ANNOYED:
      return FACE_IDX_ANGRY;
    case SAD:
      return FACE_IDX_CRYING;
    case FEAR:
    case SURPRISED:
      return FACE_IDX_SHOCKING;
    case CRINGE:
      return FACE_IDX_SMIRKING;
    case DIZZY:
      return FACE_IDX_EVIL_SMILE;
    case CONFUSED:
      return FACE_IDX_EYES_ROLLING;
    case TIRED:
      return FACE_IDX_FACE_EXHALING;
    case SHAKE:
      return FACE_IDX_REVERSE_FACE;
    case SLEEP:
      return FACE_IDX_SLEEP;
    default:
      return FACE_IDX_SMILE_NORMAL;
  }
}

/* ================= ANIMATION FUNCTIONS ================= */
void playIntroSound() {
  // Epic sci-fi intro sound
  tone(BUZZER_PIN, 523, 100);  // C5
  delay(100);
  tone(BUZZER_PIN, 659, 100);  // E5
  delay(100);
  tone(BUZZER_PIN, 784, 120);  // G5
  delay(120);
  tone(BUZZER_PIN, 1047, 150); // C6
  delay(150);
  noTone(BUZZER_PIN);
}

void playSuitsSound() {
  // Mech transformation sound - mechanical sequences
  for(int i = 0; i < 3; i++) {
    tone(BUZZER_PIN, 150 + i*50, 80);
    delay(80);
    tone(BUZZER_PIN, 250 + i*100, 100);
    delay(100);
  }
  tone(BUZZER_PIN, 600, 150);
  delay(150);
  tone(BUZZER_PIN, 800, 200);
  delay(200);
  noTone(BUZZER_PIN);
}

void playAnimatedGIF(const uint8_t (*frames)[1024], const uint16_t* delays, uint16_t frame_count) {
  for (uint16_t i = 0; i < frame_count; i++) {
    display.clearDisplay();
    display.drawBitmap(0, 0, frames[i], 128, 64, WHITE);
    display.display();
    delay(delays[i]);
  }
}

/* ================= SETUP ================= */
void setup() {
  Serial.begin(115200);
  Wire.begin(SDA_PIN, SCL_PIN);
  pinMode(TOUCH_PIN_1, INPUT);
  pinMode(TOUCH_PIN_2, INPUT);
  pinMode(BUZZER_PIN, OUTPUT);
  
  display.begin(SSD1306_SWITCHCAPVCC, OLED_ADDR);
  // ===== PLAY INTRO ANIMATION =====
  playIntroSound();
  playAnimatedGIF(nanobot_intro_frames, nanobot_intro_delays, nanobot_INTRO_FRAME_COUNT);
  
  delay(500);

  display.clearDisplay();
  display.setTextSize(2);
  display.setTextColor(WHITE);
  display.setCursor(20, 10);
  display.print("Hello!");
  display.setTextSize(1);
  display.setCursor(15, 35);
  display.print("I'm NanoBot :)");
  display.display();
  soundEffect("hi");
  delay(2500);
  
  if (!mpu.begin()) {
    display.clearDisplay();
    display.setCursor(10, 25);
    display.print("MPU6050 Error!");
    display.display();
    while(1) delay(100);
  }
  mpu.setAccelerometerRange(MPU6050_RANGE_8_G);
  mpu.setGyroRange(MPU6050_RANGE_500_DEG);
  mpu.setFilterBandwidth(MPU6050_BAND_21_HZ);
  
  display.clearDisplay();
  display.setCursor(10, 20);
  display.print("Calibrating...");
  display.setCursor(15, 35);
  display.print("Hold still!");
  display.display();
  delay(2000);
  
  for(int i = 0; i < 10; i++) {
    sensors_event_t a, g, temp;
    mpu.getEvent(&a, &g, &temp);
    delay(50);
  }
  
  display.clearDisplay();
  display.setCursor(15, 25);
  display.print("Connecting...");
  display.display();
  
  WiFi.begin(ssid, password);
  unsigned long startWifi = millis();
  while (WiFi.status() != WL_CONNECTED && (millis() - startWifi < 10000)) {
    delay(500);
  }
  
  if (WiFi.status() == WL_CONNECTED) {
    configTime(19800, 0, "pool.ntp.org");
    updateWeather();
  }
  
  interactionTimer = millis();
  moodTimer = millis();
}

/* ================= MAIN LOOP ================= */
void loop() {
  // ===== MOTION DETECTION =====
  if (millis() - lastMotionCheck > 100) {
    sensors_event_t a, g, temp;
    mpu.getEvent(&a, &g, &temp);
    
    float gyroMag = sqrt(g.gyro.x*g.gyro.x + g.gyro.y*g.gyro.y + g.gyro.z*g.gyro.z);
    float accelMag = sqrt(a.acceleration.x*a.acceleration.x + 
                          a.acceleration.y*a.acceleration.y + 
                          a.acceleration.z*a.acceleration.z);
    
    lastGyroMag = gyroMag;
    lastAccelMag = accelMag;
    
    unsigned long motionCooldown = millis() - lastMotionTrigger;
    
    if (gyroMag > 6.5 && motionCooldown > 2000) {
      if (currentMood != SHAKE) {
        currentMood = SHAKE;
        soundEffect("dizzy");
        currentScr = SCR_FACE;
        interactionTimer = millis();
        moodTimer = millis();
        lastMotionTrigger = millis();
      }
    }
    else if ((accelMag > 22.0 || accelMag < 4.0) && motionCooldown > 3000) {
      if (currentMood != FEAR) {
        currentMood = FEAR;
        soundEffect("scared");
        currentScr = SCR_FACE;
        interactionTimer = millis();
        moodTimer = millis();
        lastMotionTrigger = millis();
      }
    }
    else if (gyroMag > 2.0 && gyroMag < 5.0 && motionCooldown > 5000 && currentMood == HAPPY) {
      currentMood = PLAYFUL;
      soundEffect("playful");
      currentScr = SCR_FACE;
      interactionTimer = millis();
      moodTimer = millis();
      lastMotionTrigger = millis();
    }
    
    lastMotionCheck = millis();
  }
  
  // ===== DUAL TOUCH DETECTION =====
  bool touched1 = digitalRead(TOUCH_PIN_1);
  bool touched2 = digitalRead(TOUCH_PIN_2);
  
  // Left touch sensor (Touch 1)
  if (touched1 && (millis() - lastTouch1 > 400)) {
    soundEffect("tap");
    touchCount1++;
    lastTouch1 = millis();
    interactionTimer = millis();
    
    if (currentMood == SLEEP) {
      currentMood = HAPPY;
      soundEffect("hi");
    }
  }
  
  // Right touch sensor (Touch 2)
  if (touched2 && (millis() - lastTouch2 > 400)) {
    soundEffect("tap2");
    touchCount2++;
    lastTouch2 = millis();
    interactionTimer = millis();
    
    if (currentMood == SLEEP) {
      currentMood = HAPPY;
      soundEffect("hi");
    }
  }
  
  // Both sensors touched together - special actions!
  if (touched1 && touched2 && (millis() - lastTouch1 > 400)) {
    soundEffect("both");
    currentScr = SCR_SENSOR_DEBUG;
    touchCount1 = 0;
    touchCount2 = 0;
    lastTouch1 = millis();
    lastTouch2 = millis();
  }
  
  // Handle left touch gestures
  if (touchCount1 > 0 && (millis() - lastTouch1 > 600)) {
    switch(touchCount1) {
      case 1:
        currentScr = SCR_TIME;
        break;
      case 2:
        updateWeather();
        currentScr = SCR_WEATHER;
        break;
      case 3:
        currentScr = SCR_STATS;
        break;
      case 4:
        currentMood = LOVE;
        soundEffect("love");
        currentScr = SCR_FACE;
        moodTimer = millis();
        break;
      case 5:
        currentMood = EXCITED;
        soundEffect("excited");
        currentScr = SCR_FACE;
        moodTimer = millis();
        break;
      case 6:
        currentMood = SURPRISED;
        soundEffect("surprised");
        currentScr = SCR_FACE;
        moodTimer = millis();
        break;
      case 7:
        currentMood = PLAYFUL;
        soundEffect("playful");
        currentScr = SCR_FACE;
        moodTimer = millis();
        break;
    }
    touchCount1 = 0;
  }
  
  // Handle right touch gestures
  if (touchCount2 > 0 && (millis() - lastTouch2 > 600)) {
    switch(touchCount2) {
      case 1:
        currentMood = HAPPY;
        soundEffect("hi");
        currentScr = SCR_FACE;
        moodTimer = millis();
        break;
      case 2:
        currentMood = SAD;
        soundEffect("sad");
        currentScr = SCR_FACE;
        moodTimer = millis();
        break;
      case 3:
        currentMood = ANGRY;
        soundEffect("angry");
        currentScr = SCR_FACE;
        moodTimer = millis();
        break;
      case 4:
        currentMood = CONFUSED;
        soundEffect("confused");
        currentScr = SCR_FACE;
        moodTimer = millis();
        break;
      case 5:
        currentMood = CRINGE;
        soundEffect("cringe");
        currentScr = SCR_FACE;
        moodTimer = millis();
        break;
      case 6:
        currentMood = ANNOYED;
        soundEffect("annoyed");
        currentScr = SCR_FACE;
        moodTimer = millis();
        break;
      case 7:
        currentMood = TIRED;
        soundEffect("tired");
        currentScr = SCR_FACE;
        moodTimer = millis();
        break;
    }
    touchCount2 = 0;
  }
  
  // ===== MOOD & SCREEN TIMEOUT =====
  unsigned long idleTime = millis() - interactionTimer;
  unsigned long moodDuration = millis() - moodTimer;
  
  if (moodDuration > 5000 && 
      (currentMood == LOVE || currentMood == CRINGE || 
       currentMood == ANGRY || currentMood == DIZZY ||
       currentMood == EXCITED || currentMood == PLAYFUL ||
       currentMood == SURPRISED || currentMood == ANNOYED)) {
    currentMood = HAPPY;
  }
  
  if (moodDuration > 3000 && (currentMood == FEAR || currentMood == SHAKE)) {
    currentMood = HAPPY;
  }
  
  if (moodDuration > 8000 && (currentMood == SAD || currentMood == CONFUSED || currentMood == TIRED)) {
    currentMood = HAPPY;
  }
  
  if (idleTime > 45000 && currentMood != SLEEP) {
    currentMood = SLEEP;
    currentScr = SCR_FACE;
    soundEffect("sleepy");
  }
  
  if (idleTime > 10000 && currentMood != SLEEP && currentScr != SCR_FACE) {
    currentScr = SCR_FACE;
    if (currentMood != HAPPY && currentMood != LOVE && 
        currentMood != CRINGE && currentMood != ANGRY &&
        currentMood != EXCITED && currentMood != PLAYFUL) {
      currentMood = HAPPY;
    }
  }
  
  if (millis() - lastWeatherUpdate > 300000) {
    updateWeather();
  }
  
  // ===== RENDER SCREEN =====
  display.clearDisplay();
  
  if (currentScr == SCR_TIME) {
    struct tm timeinfo;
    if (getLocalTime(&timeinfo)) {
      int hour12 = timeinfo.tm_hour % 12;
      if (hour12 == 0) hour12 = 12;
      bool isPM = timeinfo.tm_hour >= 12;
      
      display.setTextSize(3);
      display.setCursor(18, 8);
      display.printf("%02d:%02d", hour12, timeinfo.tm_min);
      
      display.setTextSize(1);
      display.setCursor(108, 3);
      display.print(isPM ? "PM" : "AM");
      
      const char* days[] = {"Sun", "Mon", "Tue", "Wed", "Thu", "Fri", "Sat"};
      display.setTextSize(1);
      display.setCursor(45, 35);
      display.print(days[timeinfo.tm_wday]);
      
      display.setCursor(22, 50);
      display.printf("%02d/%02d/%04d", 
                     timeinfo.tm_mday, 
                     timeinfo.tm_mon + 1, 
                     timeinfo.tm_year + 1900);
    } else {
      display.setTextSize(2);
      display.setCursor(25, 25);
      display.print("No Time");
    }
  }
  else if (currentScr == SCR_WEATHER) {
    if (weather.valid) {
      display.setTextSize(1);
      display.setCursor(88, 5);
      display.print("Vizag");
      
      const unsigned char* icon = getWeatherIcon(weather.weatherCode);
      display.drawBitmap(10, 5, icon, 16, 16, WHITE);
      
      display.setCursor(30, 8);
      display.print(getWeatherDescription(weather.weatherCode));
      
      display.setTextSize(2);
      display.setCursor(10, 28);
      display.print(weather.temp, 1);
      display.print("C");
      
      display.setTextSize(1);
      display.setCursor(10, 50);
      display.print("Humidity: ");
      display.print((int)weather.humidity);
      display.print("%");
    } else {
      display.setTextSize(1);
      display.setCursor(20, 20);
      display.print("Updating...");
      display.setCursor(15, 35);
      display.print("Please wait");
    }
  }
  else if (currentScr == SCR_STATS) {
    display.setTextSize(1);
    display.setCursor(5, 2);
    display.print("== System Stats ==");
    
    display.setCursor(5, 15);
    display.print("WiFi: ");
    display.print(WiFi.status() == WL_CONNECTED ? "OK" : "Off");
    
    display.setCursor(5, 25);
    display.print("Signal: ");
    if (WiFi.status() == WL_CONNECTED) {
      display.print(WiFi.RSSI());
      display.print("dBm");
    } else {
      display.print("--");
    }
    
    display.setCursor(5, 35);
    display.print("Uptime: ");
    unsigned long uptime = millis() / 1000;
    display.print(uptime / 60);
    display.print("m ");
    display.print(uptime % 60);
    display.print("s");
    
    display.setCursor(5, 45);
    display.print("Sensors: Active");
    
    display.setCursor(5, 55);
    display.print("Touch: L+R Ready");
  }
  else if (currentScr == SCR_SENSOR_DEBUG) {
    display.setTextSize(1);
    display.setCursor(5, 2);
    display.print("== Sensor Debug ==");
    
    display.setCursor(5, 15);
    display.print("Gyro:");
    display.setCursor(5, 25);
    display.print(lastGyroMag, 2);
    display.print(" rad/s");
    
    display.setCursor(5, 38);
    display.print("Accel:");
    display.setCursor(5, 48);
    display.print(lastAccelMag, 2);
    display.print(" m/s2");
    
    display.setCursor(70, 15);
    display.print("Shake:6.5");
    display.setCursor(70, 25);
    display.print("Play:2-5");
    display.setCursor(70, 38);
    display.print("Drop:>22");
    display.setCursor(70, 48);
    display.print("Fall:<4");
    
    display.setCursor(15, 58);
    display.print("L+R to exit");
  }
  else {
    // Draw face using bitmap
    int faceIdx = getMoodFaceIndex(currentMood);
    drawFaceFromBitmap(faceIdx);
  }
  
  display.display();
  delay(30);
}
